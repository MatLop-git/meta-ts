## conf/machine/include/tsimx6.inc
```bitbake
ACCEPT_FSL_EULA = "1"

TUNE_ARCH = "arm"
DISTRO_FEATURES:remove = "wayland "
DISTRO_FEATURES:append = " x11 systemd"
DISTRO_FEATURES_BACKFILL_CONSIDERED = "sysvinit"
VIRTUAL-RUNTIME_init_manager = "systemd"
VIRTUAL-RUNTIME_initscripts = ""
```

## conf/machine/tsimx6.conf
```bitbake
#@TYPE: Machine
#@NAME: Technologic Systems Terumo SBC
#@SOC: i.MX6
#@DESCRIPTION: Machine configuration for i.MX6
#@MAINTAINER: Mark Featherston <mark@embeddedarm.com>

MACHINEOVERRIDES =. "mx6:mx6q:mx6dl:"

include conf/machine/include/imx-base.inc
include conf/machine/include/tsimx6.inc
include conf/machine/include/arm/armv7a/tune-cortexa9.inc

# Disable installing bootloader to target, however, building
# it is necessary as u-boot-fw-tools in Yocto requires a build
# of U-Boot even though it is meant to be independent from U-Boot
# itself
IMAGE_BOOTLOADER = ""
UBOOT_MACHINE = "ts7970-q-2g-1000mhz-c_defconfig"
PREFERRED_PROVIDER_virtual/bootloader = "u-boot-technologic"

# Mender variables
# All of the setup here and in U-Boot was done for SD card.
# If final release is using eMMC or SATA then the following need
# to be adjust AS WELL AS U-Boot env vars. This can be done
# by re-building U-Boot, the vars can be changed in the U-Boot
# shell, or from Linux with fw_setenv
# SD
# MENDER_STORAGE_DEVICE = "/dev/mmcblk1"
# eMMC
# MENDER_STORAGE_DEVICE = "/dev/mmcblk2"
# SATA/M.2
MENDER_STORAGE_DEVICE = "/dev/sda"

MENDER_STORAGE_TOTAL_SIZE_MB = "7168"

PREFERRED_PROVIDER_virtual/kernel ?= "linux-tslinux"

KERNEL_DEVICETREE = "imx6q-tsterumo.dtb"

KERNEL_IMAGETYPE = "uImage"

SERIAL_CONSOLE = "115200 ttymxc0"

MACHINE_ESSENTIAL_EXTRA_RDEPENDS += "kernel-devicetree linux-firmware ts4900-utils"

MACHINE_FEATURES += "screen usbhost vfat ext2 alsa 3g pci touchscreen"

hostname_pn-base-files = "ts-imx6"
IMAGE_FSTYPES = "tar.bz2"
```
